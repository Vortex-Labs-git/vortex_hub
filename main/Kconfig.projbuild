## main/Kconfig.projbuild
```kconfig
menu "Vortex Hub"

    menu "Hub Identity"

        config HUB_ID_RESET
            bool "Reset hub identity to default"
            default n
            help
                Overwrite the stored hub ID with the value below on every boot.

        config HUB_ID
            string "Hub ID (must start with VHUB, Wi-Fi name = Vortex_<ID>)"
            default "VHUB202611001"
            help
                The hub Wi-Fi is "Vortex_" + this ID. Devices that join a
                Wi-Fi whose name starts with "Vortex_VHUB" use the hub's
                local MQTT broker.

    endmenu

    menu "Hub Wi-Fi (devices connect here)"

        config HUB_AP_PASSWORD
            string "Hub Wi-Fi password (min 8 characters)"
            default "12345678"

        config HUB_AP_MAX_CLIENTS
            int "Max devices on the hub Wi-Fi"
            range 1 15
            default 10

        config HUB_TX_POWER
            int "Max TX power (0.25 dBm steps, 34 = 8.5 dBm, 84 = 21 dBm)"
            range 8 84
            default 34
            help
                Lower = smaller current peaks (no brownout on a weak supply),
                but shorter range for the devices. Raise it on a solid 5 V supply.

    endmenu


    menu "Local MQTT broker"
        config HUB_BROKER_LOG
            bool "Log every message that passes the broker"
            default y
            help
                For bench testing. Turn off once the hub is in use.

        config HUB_BROKER_ALLOW_UNKNOWN
            bool "Accept clients that are not in the device list"
            default y
            help
                For bench testing (laptop with mosquitto_sub). Turn off so
                only the listed devices can connect.

    endmenu


    menu "Devices (expected on this hub)"
        config HUB_DEVICE_TIMEOUT_S
            int "Device offline after (s) without data"
            range 10 600
            default 30

    endmenu


    menu "Server"
        config HUB_SERVER_BROKER_URI
            string "Server MQTT broker"
            default "mqtts://82.29.161.52:8882"
            help
                Same broker the devices use on a normal router.

    endmenu

    
    menu "Router (internet for hub and devices)"

        config HUB_WIFI_RESET
            bool "Reset Wi-Fi settings to default"
            default n
            help
                Overwrite the stored router / hub Wi-Fi settings on every boot.

        config HUB_ROUTER_SSID
            string "Router SSID (empty = offline hub)"
            default "OPPO_A78"

        config HUB_ROUTER_PASSWORD
            string "Router password"
            default "12345679"

    endmenu

endmenu
```
